## Kconfig
```kconfig
mainmenu "EmberLite Configuration"

source "apps/Kconfig"
source "components/Kconfig"
source "protocol/Kconfig"
source "platform/Kconfig"
source "third_party/Kconfig"
```

## components/Kconfig
```kconfig
menu "Components"

config OPENEMBER_ENABLE_CRYPTO
  bool "Build ember_crypto (CRC/MD5/SHA256)"
  default y

config OPENEMBER_ENABLE_LOGGING
  bool "Build ember_logging (builtin stderr logger)"
  default y
  help
    Lightweight C logging API (ember/log.h). No spdlog dependency.

config OPENEMBER_ENABLE_COMMON
  bool "Build ember_common (hello/random/time helpers)"
  default y
  help
    Small C utility helpers migrated from OpenEmber components/Common.

config OPENEMBER_ENABLE_NETDEV
  bool "Build ember_netdev (Linux net interface helpers)"
  default y
  depends on OPENEMBER_ENABLE_LOGGING
  help
    C API for MAC/IP/netmask/gateway/DNS/link status via ioctl/ethtool
    (migrated from OpenEmber components/Common/netdev).

config OPENEMBER_ENABLE_PPOOL
  bool "Build ember_ppool (pthread thread pool)"
  default y
  help
    Fixed-size pthread thread pool with priority task queue (C API).

endmenu
```

## core/Kconfig
```kconfig
menu "Core"

config OPENEMBER_ENABLE_RUNTIME
  bool "Build ember_runtime (FSM/node registry)"
  default y
  help
    Core runtime helpers for embedded products: a table-driven finite state
    machine and a fixed-capacity node registry. The implementation does not
    allocate memory internally.

endmenu
```

## third_party/Kconfig
```kconfig
menu "Third-party"

choice
  prompt "Third-party source mode"
  default OPENEMBER_TP_MODE_FETCH
  help
    FETCH: download archives into third_party/ cache when bundles are enabled (future).
    VENDOR: use only archives or local trees under third_party/ (no network fetch).
    SYSTEM: prefer system-installed packages where applicable.

config OPENEMBER_TP_MODE_FETCH
  bool "FETCH (download or cache under third_party/)"

config OPENEMBER_TP_MODE_VENDOR
  bool "VENDOR (local archives only, no network fetch)"

config OPENEMBER_TP_MODE_SYSTEM
  bool "SYSTEM (prefer system packages)"
endchoice

menu "Bundles (source archives in FETCH/VENDOR)"

config OPENEMBER_THIRD_PARTY_BUNDLE_NNG
  bool "Bundle: nng"
  default y
  help
    When enabled, FETCH/VENDOR mode can download/extract and build nng from source archives.

config OPENEMBER_THIRD_PARTY_BUNDLE_LCM
  bool "Bundle: lcm"
  default y
  help
    When enabled, FETCH/VENDOR mode can download/extract and build lcm from source archives.

config OPENEMBER_THIRD_PARTY_BUNDLE_ZENOHPICO
  bool "Bundle: zenoh-pico"
  default y
  help
    When enabled, FETCH/VENDOR mode can download/extract and build zenoh-pico from source archives.

endmenu

menu "Libraries (build into this project)"

config OPENEMBER_ENABLE_NNG
  bool "Build and expose nng (nanomsg-next-gen)"
  default n
  help
    When enabled, CMake resolves nng (FETCH/VENDOR/SYSTEM) and creates target emberlite::nng.

config OPENEMBER_ENABLE_LCM
  bool "Build and expose LCM"
  default n
  help
    When enabled, CMake resolves lcm and creates target emberlite::lcm.

config OPENEMBER_ENABLE_ZENOHPICO
  bool "Build and expose zenoh-pico"
  default n
  help
    When enabled, CMake resolves zenoh-pico and creates target emberlite::zenohpico.

endmenu

endmenu
```
